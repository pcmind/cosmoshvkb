## boards/shields/cosmoshk/Kconfig.defconfig
```kconfig
if SHIELD_COSMOSHK_LEFT

config ZMK_KEYBOARD_NAME
    default "Cosmoshk"

config ZMK_SPLIT_ROLE_CENTRAL
    default y

endif

if SHIELD_COSMOSHK_LEFT || SHIELD_COSMOSHK_RIGHT

config ZMK_SPLIT
    default y

endif
```

## boards/shields/cosmoshk/Kconfig.shield
```kconfig
config SHIELD_COSMOSHK_LEFT
    def_bool $(shields_list_contains,cosmoshk_left)

config SHIELD_COSMOSHK_RIGHT
    def_bool $(shields_list_contains,cosmoshk_right)
```

## config/boards/shields/cosmoshk/Kconfig.shield
```kconfig
# Copyright (c) 2020 Pete Johanson
# SPDX-License-Identifier: MIT

config SHIELD_COSMOSKB_LEFT
    def_bool $(shields_list_contains,cosmoshk_left)

config SHIELD_COSMOSKB_RIGHT
    def_bool $(shields_list_contains,cosmoshk_right)
```
